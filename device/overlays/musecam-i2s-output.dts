// Pi 3B+ output-only I2S pin group. Load before max98357a,no-sdmode.
// The default I2S group also claims GPIO20 (PCM input), used by our shutter.
/dts-v1/;
/plugin/;

/ {
    compatible = "brcm,bcm2835";

    fragment@0 {
        target = <&gpio>;
        __overlay__ {
            musecam_i2s_output_pins: musecam-i2s-output-pins {
                brcm,pins = <18 19 21>;
                brcm,function = <4>; // ALT0: PCM_CLK, PCM_FS, PCM_DOUT
                brcm,pull = <0>;
            };
        };
    };

    fragment@1 {
        target = <&i2s>;
        __overlay__ {
            pinctrl-names = "default";
            pinctrl-0 = <&musecam_i2s_output_pins>;
        };
    };
};
